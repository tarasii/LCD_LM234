#include "ext_glcd.h"


const unsigned char tableGLCDChars[256][5] = {
	
	{0x00, 0x00, 0x00, 0x00, 0x00},
	{0x00, 0x00, 0x5f, 0x00, 0x00}, //!
	{0x00, 0x07, 0x00, 0x07, 0x00}, //"
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	{0x06, 0x09, 0x09, 0x06, 0x00}, //�
	};

uint8_t curX;
uint8_t curGX;
uint8_t curY;

void GLCD_Delay(uint16_t ntimes){
	uint16_t i;
	for (i=0;i<ntimes;i++){}
}
	
void Pulse_E(void){
	HAL_GPIO_WritePin(CTRL_PORT, CTRL_E, GPIO_PIN_SET);	    //E=1
	GLCD_Delay(100);
	HAL_GPIO_WritePin(CTRL_PORT, CTRL_E, GPIO_PIN_RESET);	//E=0
	GLCD_Delay(100);
}

#define WriteCommonBit(v, bit)              \
	if ((v) & (1 << bit))                   \
		HAL_GPIO_WritePin(DATA_PORT, DATA_PIN##bit, GPIO_PIN_SET);\
	else						            \
		HAL_GPIO_WritePin(DATA_PORT, DATA_PIN##bit, GPIO_PIN_RESET);

void WriteCommon(uint8_t value)
{
	
  GPIO_InitTypeDef GPIO_InitStruct = {0};
  GPIO_InitStruct.Pin = DATA_PIN0|DATA_PIN1|DATA_PIN2|DATA_PIN3
	                   |DATA_PIN4|DATA_PIN5|DATA_PIN6|DATA_PIN7;
  GPIO_InitStruct.Mode = GPIO_MODE_OUTPUT_PP;
  GPIO_InitStruct.Pull = GPIO_NOPULL;
  GPIO_InitStruct.Speed = GPIO_SPEED_FREQ_LOW;
  HAL_GPIO_Init(DATA_PORT, &GPIO_InitStruct);

  WriteCommonBit(value, 0);
  WriteCommonBit(value, 1);
  WriteCommonBit(value, 2);
  WriteCommonBit(value, 3);
  WriteCommonBit(value, 4);
  WriteCommonBit(value, 5);
  WriteCommonBit(value, 6);
  WriteCommonBit(value, 7);

  Pulse_E();
}

void SelectChip(uint8_t value){
	if ((value&0x01) == 0x00){
		HAL_GPIO_WritePin(CRSLC_PORT, CRSLC_PIN0, GPIO_PIN_RESET);
	}
	else{
		HAL_GPIO_WritePin(CRSLC_PORT, CRSLC_PIN0, GPIO_PIN_SET);
	}
	if ((value&0x02) == 0x00){
		HAL_GPIO_WritePin(CRSLC_PORT, CRSLC_PIN1, GPIO_PIN_RESET);
	}
	else{
		HAL_GPIO_WritePin(CRSLC_PORT, CRSLC_PIN1, GPIO_PIN_SET);
	}
	if ((value&0x04) == 0x00){
		HAL_GPIO_WritePin(CRSLC_PORT, CRSLC_PIN2, GPIO_PIN_RESET);
	}
	else{
		HAL_GPIO_WritePin(CRSLC_PORT, CRSLC_PIN2, GPIO_PIN_SET);
	}
}

void DelayBusy(void)
{

	GPIO_InitTypeDef GPIO_InitStruct = {0};
	GPIO_InitStruct.Pin = DATA_PIN7;
	GPIO_InitStruct.Mode = GPIO_MODE_INPUT;
	GPIO_InitStruct.Pull = GPIO_NOPULL;
	GPIO_InitStruct.Speed = GPIO_SPEED_FREQ_LOW;
	HAL_GPIO_Init(DATA_PORT, &GPIO_InitStruct);

    int busy_state = 1;
	HAL_GPIO_WritePin(CTRL_PORT, CTRL_RS, GPIO_PIN_RESET);	//RS=0
	HAL_GPIO_WritePin(CTRL_PORT, CTRL_RW, GPIO_PIN_SET);	//RW=1
	HAL_GPIO_WritePin(CTRL_PORT, CTRL_E, GPIO_PIN_SET);	    //E=1
	while (busy_state){
		busy_state = HAL_GPIO_ReadPin(DATA_PORT, DATA_PIN7);
	}
	HAL_GPIO_WritePin(CTRL_PORT, CTRL_E, GPIO_PIN_RESET);	//E=0
	
}


void WriteCtrl(uint8_t  value){
  HAL_GPIO_WritePin(CTRL_PORT, CTRL_RS, GPIO_PIN_RESET);	//RS=0
  HAL_GPIO_WritePin(CTRL_PORT, CTRL_RW, GPIO_PIN_RESET);	//RW=0
  WriteCommon( value );
  DelayBusy();
}

void WriteData(uint8_t value)
{
  HAL_GPIO_WritePin(CTRL_PORT, CTRL_RS, GPIO_PIN_SET);	    //RS=1
  HAL_GPIO_WritePin(CTRL_PORT, CTRL_RW, GPIO_PIN_RESET);	//RW=0
  WriteCommon( value );
  DelayBusy();
}

uint8_t GetByte(void){

	uint8_t res_byte;

	GPIO_InitTypeDef GPIO_InitStruct = {0};
	GPIO_InitStruct.Pin = DATA_PIN0|DATA_PIN1|DATA_PIN2|DATA_PIN3
		                   |DATA_PIN4|DATA_PIN5|DATA_PIN6|DATA_PIN7;
	GPIO_InitStruct.Mode = GPIO_MODE_INPUT;
	GPIO_InitStruct.Pull = GPIO_NOPULL;
	GPIO_InitStruct.Speed = GPIO_SPEED_FREQ_LOW;
	HAL_GPIO_Init(DATA_PORT, &GPIO_InitStruct);

	HAL_GPIO_WritePin(CTRL_PORT, CTRL_RS, GPIO_PIN_SET);	//RS=1
	HAL_GPIO_WritePin(CTRL_PORT, CTRL_RW, GPIO_PIN_SET);	//RW=1

	GLCD_Delay(100);

	HAL_GPIO_WritePin(CTRL_PORT, CTRL_E, GPIO_PIN_SET);	//E=1
	GLCD_Delay(100);

	res_byte  = HAL_GPIO_ReadPin(DATA_PORT, DATA_PIN0);
	res_byte |= HAL_GPIO_ReadPin(DATA_PORT, DATA_PIN1) << 1;
	res_byte |= HAL_GPIO_ReadPin(DATA_PORT, DATA_PIN2) << 2;
	res_byte |= HAL_GPIO_ReadPin(DATA_PORT, DATA_PIN3) << 3;
	res_byte |= HAL_GPIO_ReadPin(DATA_PORT, DATA_PIN4) << 4;
	res_byte |= HAL_GPIO_ReadPin(DATA_PORT, DATA_PIN5) << 5;
	res_byte |= HAL_GPIO_ReadPin(DATA_PORT, DATA_PIN6) << 6;
	res_byte |= HAL_GPIO_ReadPin(DATA_PORT, DATA_PIN7) << 7;

	HAL_GPIO_WritePin(CTRL_PORT, CTRL_E, GPIO_PIN_RESET);	//E=0

	DelayBusy();

	return res_byte;
}

uint8_t GetByteXY(uint8_t gx, uint8_t y){
	uint8_t byte_state;
	GotoGXY(gx, y);
	byte_state = GetByte();
	byte_state = GetByte();
	return byte_state;
 }

void PutByte(uint8_t gx, uint8_t y, uint8_t pb){
	GotoGXY(gx, y);
	WriteData(pb);
}


void GLCD_ON(void)
{
	WriteCtrl(0x039);
}

void GLCD_OFF(void)
{
	WriteCtrl(0x038);
}

void ClearScreen(void)
{
	for(uint8_t k = 0; k < 4; k++){
		WriteCtrl(k * 0x40);
		for(uint8_t j = 0; j < 0x32; j++){
			WriteData(0x0);
		}
	}	
}

void ClearFullScreen(void)
{
	for(uint8_t i = 0; i < 4; i++)
	{
		SelectChip(i);
	
		GLCD_OFF();
		ClearScreen();
		GLCD_ON();
	}	
}

void Init_GLCD_CTRL_GPIOs(void)
{

  GPIO_InitTypeDef GPIO_InitStruct = {0};
  GPIO_InitStruct.Pin = CRSLC_PIN0 | CRSLC_PIN1| CRSLC_PIN2;
  GPIO_InitStruct.Mode = GPIO_MODE_OUTPUT_PP;
  GPIO_InitStruct.Pull = GPIO_NOPULL;
  GPIO_InitStruct.Speed = GPIO_SPEED_FREQ_LOW;
  HAL_GPIO_Init(CRSLC_PORT, &GPIO_InitStruct);

  GPIO_InitStruct.Pin =  CTRL_E | CTRL_RW | CTRL_RS;
  GPIO_InitStruct.Mode = GPIO_MODE_OUTPUT_PP;
  GPIO_InitStruct.Pull = GPIO_NOPULL;
  GPIO_InitStruct.Speed = GPIO_SPEED_FREQ_LOW;
  HAL_GPIO_Init(CTRL_PORT, &GPIO_InitStruct);

}

void Init_Ext_GLCD(void)
{

	Init_GLCD_CTRL_GPIOs();

	for(uint8_t i = 0; i < 4; i++)
	{
		//WriteCtrl(0x3F); 
		SelectChip(i);
	
		GLCD_OFF();
		
		//WriteCtrl(0x3A); //down mode (right to left)
		WriteCtrl(0x3B); //up mode (left to right)
		WriteCtrl(0x3E); //start page

		ClearScreen();
		
		GLCD_ON();
	}
}

void TestScreen(uint8_t value)
{
	for(uint8_t i = 0; i < 4; i++)
	{
		SelectChip(i);
		for(uint8_t k = 0; k < 4; k++)
		{
			WriteCtrl(k * 0x40);
			for(uint8_t j = 0; j < 0x32; j++)
			{
				WriteData(value);
			}
		}
	}
}

void TestNetScreen(void)
{
	for(uint8_t i = 0; i < 4; i++)
	{
		SelectChip(i);
		for(uint8_t k = 0; k < 4; k++)
		{
			WriteCtrl(k * 0x40);
			for(uint8_t j = 0; j < 0x32; j++)
			{
				if ((j & 0x01) == 0x00)
				{
					WriteData(0x55);
				}
				else
				{
					WriteData(0x2a);
				}

			}
		}
	}
}

void TestChars(void)
{
	uint8_t x = 0;
	for (uint8_t i = 0x21; i < 0xC1; i++){

		if ((curX+x) == 10){
			GotoXY(10, curY);
			x = 0;
		} else if ((curX+x) == 20){
			GotoXY(0, curY+1);			
			x = 0;
		}

		for (uint8_t j = 0; j < 5; j++){
			WriteData(tableGLCDChars[i-32][j]);
		}
		//PutChar(i);
		x++;
	}
}


void PutChar(uint8_t value){
	uint8_t mv = 0;
	
	if (value == 0xB0) {
		mv = 0xA0;
	}
	else if (value >= 0xE0) {
		mv = value - 0x60;
	}
	else {
		mv = value - 0x20;
	}
	
	for (uint8_t i = 0; i < 5; i++){
		WriteData(tableGLCDChars[mv][i]);
	}
}

void GotoXY(uint8_t x, uint8_t y)
{
	GotoGXY(x * 5, y);
}


void ScrollLine(uint8_t ln)
{
	uint8_t tmp[LNLEN + 1];
	int i, j;

	for (j = 0; j < 2; j++)
	{
		curY = ln;
		curX = j * 10;
		GotoXY(curX, curY);

		for (i = 0; i < LNLEN + 1; i++)
			//tmp[i] = ReadData();
			tmp[i] = GetByte();

		curY = ln-1;
		curX = j * 10;
		GotoXY(curX, curY);

		for (i = 1; i < LNLEN + 1; i++)
			WriteData(tmp[i]);
	}

}

void ScrollScreen()
{
	//
	int i, j;
	for (i = 1; i < 8; i++)
		ScrollLine(i);

	for (j = 0; j < 2; j++)
	{
		curY = 7;
		curX = j * 10;
		GotoXY(curX, curY);

		for (i = 0; i <= LNLEN; i++)
			WriteData(0x00);
	}
}

void WrapPutChar(uint8_t ch)
{
	if( !ch ) return;
	if (curX == 10)
	{
		GotoXY(10, curY);
	} else if (curX == 20){
		curY++;
		curX = 0;
		GotoXY(0, curY);
		printf("\r\n"); //new line in terminal
	}
	if (ch == 13)
	{
		curY++;
	}
	if (curY >= 8){

		ScrollScreen();

		curY = 7;
		curX = 0;
		GotoXY(curX, curY);

	}
	if (ch == 13)
	{
		curX = 0;
		GotoXY(0, curY);
		return;
	}
	PutChar(ch);
	curX++;

}

void WrapWrite_GLCD(uint8_t* message)
{
	uint8_t x = 0, mx;
	mx = 160 - curX - curY * 20;
	for(uint8_t i = 0; i < mx; i++)
	{
		if ((curX + x) == 10)
		{
			GotoXY(10, curY);
			x = 0;
		} else if ((curX + x) == 20){
			GotoXY(0, curY + 1);
			x = 0;
		}
		if( !message[i] ) break;
		PutChar(message[i]);
		x++;
	}
}

void Write_GLCD(uint8_t* message)
{
	uint8_t mx = 20 - curX;
	for(uint8_t i=0; i < mx; i++){
		if ((curX + i) == 10){
			GotoXY(10, curY);
		} 
		if( !message[i] ) break;
		PutChar(message[i]);
	}
}

void TestScroll(void)
{
	uint8_t i, j;

	unsigned char zz[20]={' ',' ',' ',' ','*',' ',' ',' ',' ','*',' ',' ',' ',' ','*',' ',' ',' ',' ','*'};
	
	GotoXY(0, 0);
	for (j = 0; j < 10; j++){
		for (i = 0; i < 10; i++){
			PutChar(zz[i + j]);
		}
	}
}

void GotoGXY(uint8_t gx, uint8_t y){
  curY = y;
  curGX = gx;
  curX = gx / 5;
  if ((gx > LNLEN - 1)&&(y > 3)) {
		SelectChip(3);
		gx -= LNLEN;
		y -= 4;
		}
	else		
  if ((gx > LNLEN - 1)&&(y < 4)) {
		SelectChip(1);
		gx -= LNLEN;
	}
	else
  if ((gx < LNLEN)&&(y > 3)) {
		SelectChip(2);
		y -=4;
	}
	else
  if ((gx < LNLEN)&&(y < 4)) {
		SelectChip(0);
	}
	WriteCtrl(y * 0x40 + gx);
}


void PutPixel(uint8_t gx, uint8_t gy)
{
	uint8_t y;
	uint8_t nbit;
	uint8_t lcd_byte;

	y = gy / 8;
	nbit = gy - y * 8;
	lcd_byte = GetByteXY(gx,y);
	GotoGXY(gx, y);
	lcd_byte |= 1 << nbit;
	WriteData(lcd_byte);
}

int abs(int x){
	int res;
	if(x<0){res=-x;}
	else {res = x;}
	return res;
}

void drawLine(int x1, int y1, int x2, int y2) {
    const int deltaX = abs(x2 - x1);
    const int deltaY = abs(y2 - y1);
    const int signX = x1 < x2 ? 1 : -1;
    const int signY = y1 < y2 ? 1 : -1;
    //
    int error = deltaX - deltaY;
		int error2;
    //
    PutPixel(x2, y2);
    while(x1 != x2 || y1 != y2) {
        PutPixel(x1, y1);
        error2 = error * 2;
        //
        if(error2 > -deltaY) {
            error -= deltaY;
            x1 += signX;
        }
        if(error2 < deltaX) {
            error += deltaX;
            y1 += signY;
        }
    }
 
}

void Rectangle(int x1, int y1, int x2, int y2) {
	drawLine(x1, y1, x2, y1);
	drawLine(x2, y1, x2, y2);
	drawLine(x1, y2, x2, y2);
	drawLine(x1, y1, x1, y2);
}


